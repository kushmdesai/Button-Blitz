#include <Wire.h>
#include <Adafruit_GFX.h>
#include <Adafruit_SSD1306.h>

#define SCREEN_WIDTH 128
#define SCREEN_HEIGHT 32

Adafruit_SSD1306 display(SCREEN_WIDTH, SCREEN_HEIGHT, &Wire, -1);  // -1 = no reset

const int ledPins[4] = {3, 4, 5, 6};     // LED pins
const int buttonPins[4] = {7, 8, 9, 10}; // Button pins (active low)

int score = 0;
int highScore = 0;
bool gameOver = false;

// Difficulty control
const int baseTime = 1000; // ms
const int minTime = 300;   // ms
void displayLogo();
void setup() {
  Serial.begin(9600);
  randomSeed(analogRead(A0));

  for (int i = 0; i < 4; i++) {
    pinMode(ledPins[i], OUTPUT);
    pinMode(buttonPins[i], INPUT_PULLUP);
  }

  if (!display.begin(SSD1306_SWITCHCAPVCC, 0x3C)) {
    Serial.println("OLED not found");
    while (1);
  }
  displayLogo();
  delay(2000); // Show logo for 2 seconds

  showSplash(); // then show your text splash
  waitForAnyButton();
}

void blinkMessage(String msg, int times = 3, int delayMs = 300) {
  for (int i = 0; i < times; i++) {
    display.clearDisplay();
    display.display();
    delay(delayMs);
    display.setCursor(0, 0);
    display.setTextSize(1);
    display.println(msg);
    display.display();
    delay(delayMs);
  }
}

void loop() {
  if (gameOver) {
    waitForAnyButton();
    score = 0;
    gameOver = false;
    delay(300);  // debounce
  }

  int target = random(0, 4);
  digitalWrite(ledPins[target], HIGH);

  // Make reaction time scale with score
  int reactionTime = max(minTime, baseTime - score * 50);
  unsigned long startTime = millis();
  bool pressed = false;
  bool correct = false;

  while (millis() - startTime < reactionTime) {
    for (int i = 0; i < 4; i++) {
      if (digitalRead(buttonPins[i]) == LOW) {
        pressed = true;
        if (i == target) correct = true;
        break;
      }
    }
    if (pressed) break;
  }

  // Turn off LEDs
  for (int i = 0; i < 4; i++) {
    digitalWrite(ledPins[i], LOW);
  }

  if (correct) {
    score++;
    if (score > highScore) highScore = score;
    showScore();
  } else {
    blinkMessage("Game Over!\nScore: " + String(score) + "\nHigh: " + String(highScore), 3, 400);
    showMessage("Press any button.");
    gameOver = true;
  }

  delay(600); // brief pause
}

// ==== Display Functions ==== //

void showSplash() {
  display.clearDisplay();
  display.setTextSize(2);
  display.setCursor(0, 0);
  display.println("Button");
  display.println("Blitz!");
  display.setTextSize(1);
  display.println("Press any");
  display.println("button...");
  display.display();
}

void showScore() {
  display.clearDisplay();
  display.setCursor(0, 0);
  display.setTextSize(1);
  display.print("Score: ");
  display.println(score);
  display.print("High: ");
  display.println(highScore);
  display.print("Level: ");
  display.println((score / 3) + 1);
  display.display();
}

void showMessage(String msg) {
  display.clearDisplay();
  display.setCursor(0, 0);
  display.setTextSize(1);
  display.println(msg);
  display.display();
}

const uint8_t logoBitmap [] PROGMEM = {
  // 'Button-Blitz-Logo', 128x32px
  0x00, 0x00, 0x00, 0x00, 0x00, 0x00, 0x00, 0x00, 0x00, 0x00, 0x00, 0x00, 0x00, 0x00, 0x00, 0x00, 
  0x00, 0x00, 0x00, 0x00, 0x00, 0x00, 0x00, 0x00, 0x00, 0x00, 0x00, 0x00, 0x00, 0x00, 0x00, 0x00, 
  0x00, 0x00, 0x00, 0x00, 0x00, 0x00, 0x00, 0x00, 0x00, 0x00, 0x00, 0x00, 0x00, 0x00, 0x00, 0x00, 
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  0x00, 0x00, 0x00, 0x00, 0x00, 0x00, 0x00, 0x00, 0x00, 0x00, 0x00, 0x00, 0x00, 0x00, 0x00, 0x00
};

void displayLogo() {
  display.clearDisplay();
  display.drawBitmap(0, 0, logoBitmap, 128, 32, SSD1306_WHITE);
  display.display();
};

// ==== Button Utility ====

bool anyButtonPressed() {
  for (int i = 0; i < 4; i++) {
    if (digitalRead(buttonPins[i]) == LOW) return true;
  }
  return false;
}

void waitForAnyButton() {
  while (!anyButtonPressed()) {
    delay(10);
  }
}
